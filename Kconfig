## Kconfig
```kconfig
# General configuration
#

mainmenu "XHYP Configuration"

config HAVE_DOT_CONFIG
	bool
	default y

choice 
	prompt "Processor family"
	default ARM
	help
	  Choose the corresponding processor
config ARM
	bool "ARM"
config LEON
	bool "LEON"
config MIPS
	bool "MIPS"
config SH4
	bool "SH4"
config X86
	bool "Intel"

endchoice

source "arch/arm/Kconfig"
source "arch/leon/Kconfig"
source "arch/mips/Kconfig"
source "arch/sh4/Kconfig"
source "arch/x86/Kconfig"

source "kernel/Kconfig"

config PREFIX
        string "Cross compilator prefix"
        default "arm-linux-"
        help
	  define the cross compiler prefix

source "drivers/Kconfig"
```

## arch/arm/Kconfig
```kconfig
# ARM configuration
#

menu "Board"
	depends on ARM

choice
	prompt "ARM SOC"
	default BOARD_VERSATILE
	help
	  Supported ARM based platform

config BOARD_VERSATILE
	bool "Versatile ARM926EJS"

config BOARD_GEAM6425
	bool "GEAM6425 ARM926EJS"

config BOARD_REALVIEW
	bool "Realview CORTEX A8"

config BOARD_BEAGLE
	bool "Beagle-Board Cortex A8"

endchoice

config MEMORY_SIZE
	hex "Platform memory size (default to 128M)"
	default 0x08000000
	help
	  default to 128M

config PERIPH_BASE
	hex "Peripheral base address"
	default 0x10000000

config PERIPH_SIZE
	hex "Peripheral address size"
	default 0x02000000

endmenu
```

## arch/arm/beagle/Kconfig
```kconfig
menuconfig MENU_BEAGLE
	bool "Beagle Board"
	depends on BOARD_BEAGLE

if MENU_BEAGLE

comment "-------- Nothing to do ----------"

endif
```

## arch/arm/realview/Kconfig
```kconfig
menuconfig MENU_REALVIEW
	bool "Realview board"
	depends on BOARD_REALVIEW

if MENU_REALVIEW

comment "-------- Nothing to do ----------"

endif
```

## arch/arm/versatile/Kconfig
```kconfig
menuconfig MENU_VERSATILE
	bool "Versatile peripherals"
	depends on BOARD_VERSATILE

if MENU_VERSATILE

menuconfig PL011
	bool "PL011 serial controller"
	default y
	---help---
	  Standard Versatile UART

if PL011
config PL011_OFFSET
        hex "PL011 address offset"
        depends on PL011
        default 0x001F1000
        ---help---
          Offset for the PL011 chip
endif

menuconfig LAN91C111
	bool "SMC LAN91C111"
	default y
	---help---
	  Standard Versatile Ethernet controller

if LAN91C111
config LAN91C111_OFFSET
        hex "LAN91C111 address offset"
        depends on LAN91C111
        default 0x001F1000
        ---help---
          Offset for the PL011 chip
endif



endif
```

## drivers/Kconfig
```kconfig
menu 'Secure Drivers'

config QPORT_CONSOLE
	bool "Qport console"
	help
	  XHYP qport console

config VIRTIO_CONSOLE
	bool "Virtio console"
	help
	  XHYP virtio console

config NETWORK
	bool "network"
	help
	  XHYP network

config DISK
	bool "disk"
	help
	  XHYP disk

endmenu
```

## kernel/Kconfig
```kconfig
# General configuration
#

menu "Hypervizor"

config DEBUG
	bool "Debuging XHYP"
	default n
	help
	  Helps you debugging your domains

config XHYP_XIP
	bool "XHYP execute in place"
	default n
	help
	  Use this if XHYP excutes from ROM

config STACK_SIZE
	hex "XHYP stack size"
	default 0x1000
	help
	  This is the Hypervizor stack size
	  default is one page.

# The timer period
#
config TIMER_PERIOD
	int "Timer period in ms"
	default 10
	help
	  This is the timer period.
	  For POSIX scheduling it will determine maximal latency when
	  the kernel is not preemptible and no interrupt are allowed

	  For ARINC it will determine the minimal minor frame size.

	  For EDF it will determine the minimal deadline and budget.

# Preemption model
#
choice
	prompt "Preemption Model"
	default PREEMPT_NONE


config	PREEMPT_NONE
	bool "No preemption during hypercalls"
	help
	  No preemption during hypercalls

config PREEMPT_HYP
	bool "Preemtible hypervisor"
	help
	  Hypercalls may be preempted

endchoice

# Scheduler type

choice 
	prompt "XHYP Scheduler"
	default SCHED_POSIX

config SCHED_ARINC
	bool "ARINC-653 Scheduler"
	help
	  Scheduler with fixed round robin scheduling
	  and fixed per partition time slices.

config SCHED_POSIX
	bool "POSIX scheduler"
	help
	  Scheduler with monotonic priorities.
	  Provides SCHED_FIFO and SCHED_RR.

config SCHED_EDF
	bool "EDF Scheduler"
	help
	  Scheduler based on the EDF Scheduler
	  with budget and deadlines for each partition.

config SCHED_CBS
	bool "CBS Scheduler"
	help
	  Scheduler based on the EDF Scheduler
	  with periodic scheduling of the partitions.

endchoice

if !SCHED_POSIX

config SCHED_SPORADIC
	bool "Add Sporadic scheduling"
	help
	  not depending on the basic scheduler on specific events
	  one partition is being prioritized.

	  This allows for low latency on emergency.
endif

if SCHED_ARINC

config ARINC_INT
	bool "Domain Interrupt protection"
	default n
	help
	  The hypervizor will not allow interrupt for
	  one domain to occur in another domain.

config ARINC_POLL
	bool "Use polling and no interrupt"
	default n
	help
	  Not interrupt are allowed but the timer
	  interrupt to schedule partitions.

config ARINC_SPORADIC
	bool "Sporadic scheduling on domain switch"
	depends on SCHED_SPORADIC
	default n
	help
	  Usually sporadic scheduling appears on interrupt
	  dedicated for this emergency.

	  Using this switch, sproradic scheduling takes
	  place only on domain switch.

endif

endmenu
```
